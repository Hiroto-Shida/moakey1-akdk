## boards/shields/moakey1/Kconfig.defconfig
```kconfig
if SHIELD_MOAKEY1_LEFT

config ZMK_KEYBOARD_NAME
    default "moakey1"

endif

if SHIELD_MOAKEY1_LEFT || SHIELD_MOAKEY1_RIGHT

config ZMK_SPLIT
    default y

endif
```

## boards/shields/moakey1/Kconfig.shield
```kconfig
config SHIELD_MOAKEY1_LEFT
    def_bool $(shields_list_contains,moakey1_left)
config SHIELD_MOAKEY1_RIGHT
    def_bool $(shields_list_contains,moakey1_right)
```
